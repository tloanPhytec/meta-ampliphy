## conf/distro/ampliphy-xwayland-retro.conf
```bitbake
require ampliphy.conf
require conf/distro/include/retro-arm-familly.inc
require conf/distro/include/retro-common.inc
require conf/distro/include/retro-raspberrypi.inc
require conf/distro/include/retro-x86-familly.inc

DISTRO = "ampliphy-xwayland-retro"
DISTRO_NAME = "ampliPHY XWayland (Phytec XWayland Distribution) + Retro"

DISTRO_FEATURES += " \
   ${RETRO_FEATURES} \
   acl \
   alsa \
   bluetooth \
   ext2 \
   gobject-introspection-data \
   gtk+3 \
   ipv4 \
   ipv6 \
   kodi \
   largefile \
   nfs \
   opengl \
   pam \
   polkit \
   pulseaudio \
   samba \
   systemd \
   wayland \
   wifi \
   x11 \
   zeroconf \
"
IMAGE_INSTALL:append = " coreutils iptables iproute2"
```
